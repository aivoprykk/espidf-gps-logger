## main/Kconfig
```kconfig
menu "Logger Version"
    choice
        bool "Logger build mode"
        default LOGGER_BUILD_MODE_PROD
        config LOGGER_BUILD_MODE_PROD
            bool "Production"
        config LOGGER_BUILD_MODE_DEV
            bool "Development"
    endchoice
    config LOGGER_BUILD_MODE
    int
        default 0 if LOGGER_BUILD_MODE_PROD
        default 1 if LOGGER_BUILD_MODE_DEV
    config LOGGER_VERSION_MAJOR
        int "Logger Version Major"
        default 1
    config LOGGER_VERSION_MINOR
        int "Logger Version Minor"
        default 0
    config LOGGER_VERSION_PATCH
        int "Logger Version Patch"
        default 4
    config LOGGER_VERSION_BUILD
        int "Logger Version Build"
        default 2
endmenu
```
